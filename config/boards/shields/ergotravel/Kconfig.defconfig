## config/boards/shields/ergotravel/Kconfig.defconfig
```kconfig
if SHIELD_ERGOTRAVEL_LEFT

config ZMK_KEYBOARD_NAME
	default "ErgoTravel Left"

endif

if SHIELD_ERGOTRAVEL_RIGHT

config ZMK_KEYBOARD_NAME
	default "ErgoTravel Right"

endif
```
